## main/Kconfig.projbuild
```kconfig
menu "Blynk Rele Configuration"

    config WIFI_SSID
        string "WiFi SSID"
        default "myssid"
        help
            Nombre de la red WiFi a la que se conecta el ESP32.

    config WIFI_PASSWORD
        string "WiFi Password"
        default "mypassword"
        help
            Contrasena de la red WiFi.

    config BLYNK_AUTH_TOKEN
        string "Blynk Auth Token"
        default "your_blynk_token_here"
        help
            Token de autenticacion de Blynk Cloud.

    config BLYNK_TEMPLATE_ID
        string "Blynk Template ID"
        default "your_template_id_here"
        help
            ID de la plantilla en Blynk Cloud.

endmenu
```
